## conf/distro/poky-rwt.conf
```bitbake
require conf/distro/poky.conf

#PACKAGE_CLASSES ?= "package_ipk"

DISTRO_FEATURES:append = " systemd wifi bluetooth opengl"
DISTRO_FEATURES_BACKFILL_CONSIDERED += " sysvinit"
VIRTUAL-RUNTIME_init_manager = "systemd"
VIRTUAL-RUNTIME_initscripts = "systemd-compat-units"
INIT_MANAGER = "systemd"


#PACKAGECONFIG_pn-boost = "locale python"
#PACKAGECONFIG_pn-systemd:append = " networkd timedated timesyncd logind resolved hostnamed"



DISTRO = "poky-rwt"
DISTROOVERRIDES = "poky"

# Resolving issue where we are using a version of meta-xilinx that supports
# "thud" for use with Yocto "warrior". It tries to patch gcc-7 to support
# the Microblaze; however, gcc-7 doesn't exist in warrior.
#BBMASK += "/recipes-microblaze/gcc/gcc-source_7.%.bbappend"
```

## conf/layer.conf
```bitbake
#We have a conf and classes directory, add to BBPATH
BBPATH .= ":${LAYERDIR}"

# We have recipes-* directories, add to BBFILES
BBFILES += "${LAYERDIR}/recipes-*/*/*.bb \
	${LAYERDIR}/recipes-*/*/*.bbappend"

BBFILE_COLLECTIONS += "meta-rwt-common"
BBFILE_PATTERN_meta-rwt-common = "^${LAYERDIR}/"
BBFILE_PRIORITY_meta-rwt-common = "6"

LAYERSERIES_COMPAT_meta-rwt-common = "warrior zeus"
```

## conf/machine/include/arm/arch-armv8.inc
```bitbake
# This corrects an pre-warrior meta-xilinx director that that is unaware of 
# the new naming.

require conf/machine/include/arm/arch-armv8a.inc
```
